## bbpC-blueretro/sdkconfig.defaults
```kconfig
#
# Partition Table
#
CONFIG_PARTITION_TABLE_CUSTOM=y
CONFIG_PARTITION_TABLE_CUSTOM_FILENAME="../partitions.csv"
CONFIG_ESPTOOLPY_FLASHSIZE_4MB=y

#
# Bluetooth Configuration (required by esp-nimble-cpp / BLE Gamepad)
#
CONFIG_BT_ENABLED=y
CONFIG_BT_NIMBLE_ENABLED=y
CONFIG_BT_BLE_ENABLED=y

#
# BluControl SDK Configuration
#
CONFIG_BLUCONTROL_MODE_LENGTH=2
CONFIG_BLUCONTROL_MODE1_LED_GPIO=16
CONFIG_BLUCONTROL_MODE2_LED_GPIO=-1
CONFIG_BLUCONTROL_SECONDS_FOR_SWITCH_MODE=5
CONFIG_BLUCONTROL_SWITCH_BUTTONS_LENGTH=3
CONFIG_BLUCONTROL_SWITCH_BUTTON1_GPIO=23
CONFIG_BLUCONTROL_SWITCH_BUTTON2_GPIO=21
CONFIG_BLUCONTROL_SWITCH_BUTTON3_GPIO=18
# end of BluControl SDK Configuration
```

## bbpC-sdk/bbpC-components/Kconfig
```kconfig
menu "bebopCORE Configuration"

    choice BBPCORE_PINOUT_TYPE
        prompt "Pinout type"
        default BBPCORE_PINOUT_TYPE_ORIGINAL
        help
            Select which pinout will you use. For reference, the original uses GPIO22 for Z, while Yakara's uses GPIO33

        config BBPCORE_PINOUT_TYPE_ORIGINAL
            bool "Original"

        config BBPCORE_PINOUT_TYPE_YAKARA
            bool "Yakara's"
    endchoice

endmenu
```

## n64-switch/sdkconfig.defaults
```kconfig
#
# BluControl SDK Configuration
#
CONFIG_BLUCONTROL_MODE_LENGTH=2
CONFIG_BLUCONTROL_MODE1_LED_GPIO=4
CONFIG_BLUCONTROL_MODE2_LED_GPIO=-18
CONFIG_BLUCONTROL_SECONDS_FOR_SWITCH_MODE=5
CONFIG_BLUCONTROL_SWITCH_BUTTONS_LENGTH=2
CONFIG_BLUCONTROL_SWITCH_BUTTON1_GPIO=35
CONFIG_BLUCONTROL_SWITCH_BUTTON2_GPIO=32
# end of BluControl SDK Configuration
```
